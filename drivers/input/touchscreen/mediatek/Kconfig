## drivers/input/touchscreen/mediatek/Kconfig
```kconfig
#
# Touchscreen driver configuration
#
menuconfig INPUT_TOUCHSCREEN
	bool "Touchscreens"
	help
	  Say Y here, and a list of supported touchscreens will be displayed.
	  This option doesn't affect the kernel.

	  If unsure, say Y.

if INPUT_TOUCHSCREEN

config TOUCHSCREEN_MTK
	bool "MediaTek Touch Panel Driver"
	help
	  Say Y here if you have MediaTek touch panel.

	  If unsure, say N.

	  To compile this dirver as a module, choose M here: the
	  module will be called.

endif
```

## drivers/misc/mediatek/Kconfig
```kconfig
menuconfig MEDIATEK_SOLUTION
	bool "MediaTek Properitary Configuration"
	select FW_LOADER_USER_HELPER_FALLBACK
	help
	  Check this to enable MediaTek properity configuration.

if MEDIATEK_SOLUTION

config MTK_PLATFORM
	string "MTK platform name"

config ARCH_MTK_PROJECT
	string "MTK project name"

config MTK_LEGACY
	bool "MTK LEGACY driver API support"
	help
	  This is an option for MTK legacy driver that using old API
	  It will be deprecated after all drivers changed to new structure

config MTK_INTERNAL
	bool "Enable MTK internal debug feature"
	help
	  Identify if codebase is built with MTK internal debug
	  (Don't modify this feature option setting.)

config FPGA_EARLY_PORTING
	bool "FPGA_EARLY_PORTING"
	help
	   Used for FPGA early porting to separate code segments between FPGA
	   platform and non-FPGA platform

config MTK_LM_MODE
	bool "MTK Large Memory mode"
	select ARM_LPAE if !ARM64
	select ARCH_PHYS_ADDR_T_64BIT
	select ARCH_DMA_ADDR_T_64BIT
	help
	  Large Memory mode support for supporting more than 4GB DRAM access

endif

config MTK_MEM
	bool "Support platform memory information"
	default y
	help
	  MTK_MEM provides basic platform memory information
	  for mediatek platform drivers. It also provides
	  some debug features. Please see
	  MTK_MEMCFG.

config MTK_DCS
	bool "Support Mediatek DDRPHY DCS mechanism"
	depends on MTK_MEMORY_LOWPOWER
	default n
	help
	  Mediatek DDRPHY DCS mechanism.
	  It tries to turn off free DDRPHY's power/clock.
	  This can help system reduce power consumption.
	  It is based on MTK_MEMORY_LOWPOWER technology.

config MTK_PASR
	bool "Support Mediatek DRAM PASR mechanism"
	depends on MTK_MEMORY_LOWPOWER
	default n
	help
	  Mediatek DRAM PASR mechanism.
	  It tries to turn off free DRAM segment's self-refresh.
	  This can help system reduce power consumption.
	  It is based on MTK_MEMORY_LOWPOWER technology.

config MTK_BASE_POWER
	bool

config MTK_POWER_GS
	bool

config MTK_SHARED_SDCARD
	bool "MTK_SHARED_SDCARD"
	help
	  sdcard will be a folder of /data

config MTK_GPT_SCHEME_SUPPORT
        bool "MTK_GPT_SCHEME_SUPPORT"
	help
	  GPT is GUID Partition Table
	  MTK driver support gpt scheme layout
	  GPT is a better partition layout scheme
	  GPT is instead of PMT

config MTK_SENSOR_SUPPORT
	bool "MTK_SENSOR_SUPPORT"
	help
	  sensor config to sensor port sensor feature in project.

config CUSTOM_KERNEL_IMGSENSOR
	string "CUSTOM_KERNEL_IMGSENSOR"
	help
	  Kernel space image sensor driver. Define  project used all image
	  sensors .The value is combination of CUSTOM_KERNEL_MAIN_IMGSENSOR,
	  CUSTOM_KERNEL_MAIN_BACKUP_IMGSENSOR, CUSTOM_KERNEL_SUB_IMGSENSOR,
	  and CUSTOM_KERNEL_SUB_BACKUP_IMGSENSOR

config MT_ENG_BUILD
	bool "flag for MTK eng/usr build verification"
	default n
	help
	  Y means this kernel version is engineering mode and has more debugging
	  features built-in. This option is supposed to specifiy engineering or
	  user load for this build.
	  If you are not sure about this, set n

config MTK_SEC_VIDEO_PATH_SUPPORT
	bool "Enable MTK Secure Video Path Support"
	depends on (MTK_IN_HOUSE_TEE_SUPPORT) || (TRUSTONIC_TEE_SUPPORT) || (TRUSTY)
	default n
	help
	  This enable MTK Secure Video Path Support. (depending on
	  MTK In-House TEE Support or Trustonic TEE Support)

config MTK_LDVT
	bool "LDVT"
	default n
	help
	  Support LDVT or not

source "drivers/misc/mediatek/gpt/Kconfig"
source "drivers/misc/mediatek/uart/Kconfig"
source "drivers/misc/mediatek/auxadc/Kconfig"
source "drivers/misc/mediatek/videocodec/Kconfig"
source "drivers/misc/mediatek/m4u/Kconfig"
source "drivers/misc/mediatek/leds/Kconfig"
source "drivers/misc/mediatek/vibrator/Kconfig"
source "drivers/misc/mediatek/jpeg/Kconfig"
source "drivers/misc/mediatek/power/Kconfig"
source "drivers/misc/mediatek/pmic_wrap/Kconfig"
source "drivers/misc/mediatek/mtprof/Kconfig"
source "drivers/misc/mediatek/cmdq/Kconfig"
source "drivers/misc/mediatek/smi/Kconfig"
source "drivers/misc/mediatek/base/power/Kconfig"
source "drivers/misc/mediatek/boot/Kconfig"
source "drivers/misc/mediatek/boot_reason/Kconfig"
source "drivers/misc/mediatek/chip/Kconfig"
source "drivers/misc/mediatek/devinfo/Kconfig"
source "drivers/misc/mediatek/gpu/Kconfig"
source "drivers/misc/mediatek/mmp/Kconfig"
source "drivers/misc/mediatek/lcm/Kconfig"
source "drivers/misc/mediatek/video/Kconfig"
source "drivers/misc/mediatek/dramc/Kconfig"
source "drivers/misc/mediatek/sync/Kconfig"
 
source "drivers/misc/mediatek/pwm/Kconfig"
source "drivers/misc/mediatek/accelerometer/Kconfig"
source "drivers/misc/mediatek/alsps/Kconfig"
source "drivers/misc/mediatek/gyroscope/Kconfig"
source "drivers/misc/mediatek/hwmon/Kconfig"
source "drivers/misc/mediatek/freqhopping/Kconfig"
source "drivers/misc/mediatek/cirq/Kconfig"
source "drivers/misc/mediatek/accdet/Kconfig"
source "drivers/misc/mediatek/masp/Kconfig"
source "drivers/misc/mediatek/debug_latch/Kconfig"
source "drivers/misc/mediatek/systracker/Kconfig"
source "drivers/misc/mediatek/ram_console/Kconfig"
 
source "drivers/misc/mediatek/sched/Kconfig"
source "drivers/misc/mediatek/dynamic_boost/Kconfig"
source "drivers/misc/mediatek/trustzone/Kconfig"
source "drivers/misc/mediatek/imgsensor/Kconfig"
source "drivers/misc/mediatek/gps/Kconfig"
source "drivers/misc/mediatek/connectivity/Kconfig"
source "drivers/misc/mediatek/nfc/Kconfig"
source "drivers/misc/mediatek/lens/Kconfig"
source "drivers/misc/mediatek/flashlight/Kconfig"
source "drivers/misc/mediatek/aee/Kconfig"
source "drivers/misc/mediatek/thermal/Kconfig"
source "drivers/misc/mediatek/rtc/Kconfig"
source "drivers/misc/mediatek/atf_log/Kconfig"
source "drivers/misc/mediatek/ssusb/Kconfig"
source "drivers/misc/mediatek/mlog/Kconfig"
source "drivers/misc/mediatek/emi_bwl/Kconfig"
source "drivers/misc/mediatek/emi_mpu/Kconfig"
source "drivers/misc/mediatek/emi_mbw/Kconfig"
 
source "drivers/misc/mediatek/ice_debug/Kconfig"
source "drivers/misc/mediatek/ext_gic/Kconfig"
 
source "drivers/misc/mediatek/selinux_warning/Kconfig"
```

## drivers/misc/mediatek/mtprof/Kconfig
```kconfig
config MTPROF
	bool "Enable MTK profiler/debugger tool"
	help
	  CONFIG_MTPROF define if mtk profiling tools should be built-in or not. It
	  includes workqueue debugger, signal debugger, cputime, bootprof, and other
	  misc tools. If you are not sure about whether to enable it or not, please
	  set n.

if MTPROF

config MTK_LOCK_DEBUG
	bool "Support some MTK lock debug patches"
	default y
	help
	  CONFIG_MTK_LOCK_DEBUG is used to catch db when spinlock spin more than 1s and to catch
	  db when check lock fail,such as bug_header,circular_bug,deadlock_bug and so on
	  Say Y here to enable, If you are not sure about whether to enable it or not, please
	  set n.

config MTPROF_CPUTIME
	bool "thread cputime profiling"
	depends on SCHEDSTATS
	help
	  CONFIG_MTPROF_CPUTIME is used to measure process/irq execution time and export
	  the information in /proc/mtprof/cputime. Say Y here to enable thread cputime
	  profiling. If you are not sure about whether to enable it or not, please
	  set n.

config MTK_WQ_DEBUG
	bool "mtk workqueue debug"
	help
	  CONFIG_MTK_WQ_DEBUG define if workqueue debugging should be built-in or not
	  It will add logs to monitor work activation, queue, and execution. Say y to
	  enable mtk workqueue debug, or if you are not sure about this, please
	  set n

config MT_SCHED_MONITOR
	bool "mt scheduler monitor"
	default n
	help
	  MT_SCHED_MONITOR is used to monitor ISR/SOFTIRQ/TASKLET/HRTIMER/STIMER/PREEPT
	  disable duration. Say Y here to enable ISR/SOFTIRQ/TASKLET/HRTIMER/STIMER
	  monitor. If you are not sure about whether to enable it or not, please
	  set n.

config MT_RT_THROTTLE_MON
	bool "mt rt throttle monitor"
	default n
	help
	  MT_RT_THROTTLE_MON is used to monitor rt throttle. When rt throttle activated
	  print 5 longest execusion time rt tasks. Say Y here to enable rt throttle
	  monitor. If you are not sure about whether to enable it or not, please set n.

endif
```

## drivers/misc/mediatek/tc1_interface/Kconfig
```kconfig
config MTK_TC1_FEATURE
	bool "MTK_TC1_FEATURE"
	default n
	help
	  MTK_TC1_FEATURE
```

## drivers/staging/imgtec/Kconfig
```kconfig
source "drivers/staging/imgtec/rogue/Kconfig"
source "drivers/staging/imgtec/mt8173/Kconfig"
```

## drivers/staging/imgtec/mt8173/Kconfig
```kconfig
config POWERVR_MT8173
	bool "PowerVR MT8173 support"
	default y
	depends on POWERVR_ROGUE
	depends on ARCH_MT8173
```

## sound/soc/mediatek/Kconfig
```kconfig
config SND_SOC_MT8173
    tristate

config SND_SOC_MT8173_MT6391_MACH
    tristate "ASoC Audio driver for MT8173 with MT6391 codec"
    depends on ARCH_MT8173
    select SND_SOC_MT8173
    select SND_SOC_MT6391
    help
        This adds audio driver for MT8173 platform with the MT6391 audio codec.
```

## sound/soc/mediatek/mt2701/Kconfig
```kconfig
choice
	prompt "MT2701 ASOC platform"


config SND_SOC_MT2701_EVB
	bool "MT2701 EVB"

	help
	  Say Y if you want to use the MT2701 EVB
	  Audio interfaces for MT2701.

endchoice
```
